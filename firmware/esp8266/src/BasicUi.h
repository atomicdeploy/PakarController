// Generated by tools/generate-basic-ui.mjs; edit assets/web/basic* instead.
#pragma once
#include <Arduino.h>
static const char kBasicUi[] PROGMEM = R"BASIC(<!doctype html>
<html lang="en"><head><meta charset="utf-8"><meta name="viewport" content="width=device-width,initial-scale=1"><meta name="color-scheme" content="dark"><title>PakarController · Cells</title><link rel="icon" href="data:image/png;base64,iVBORw0KGgoAAAANSUhEUgAAAEAAAABACAYAAACqaXHeAAACq0lEQVR42u2av2sUQRTHT2MsJASJdqZKUP8ABRuxEBJ/nFoF0thdzn9ARC18xfG6i6+yCdopEUwE7Y2lBJMQqxSiaGwURBDBGFGjOzAHw2N2du5wYN/e+8K3mZ2Znfe5mdmZm6nVVCqVSqVSqVSqoADJeBiQEJCWAGm1RF4BpAVAmrLtTALABP8akP6W3K1UAFBA8Ma/AWksBYAl5yXfC7qk26DPgXwbLO/7HocAr2c6BQA3sNXOWMux25i5QL5jLO+Vgnqj61EACkABiATQ7jcAY57P2NV+AmB83wPhRj8B2GOXsRzCA0Bas2uOt4C0CEjHqwggBIH7VwbkmjQAdyO7cSyEHUA6LQnAFiBNREI46Qn2OSBtsvRXkgB0IExGALjFyjVt+gAgLbMNzz5JAGIhECsz6jxrsWdHpAEw/gFIZwLlZlj+WUDaa0G8cdK3AWlQCoAdD4SzOeWO2pmeb6d52jNJc8DDrOu/8EA4l1O26I+XLQtK1DpguAsIpsvf8fQc40+AdF7qQsgHYTsnIONTgHTbdvdHgHQzA3NQ+kowD0K9x12gyKVwHoQL/QIgBOFiFQDsZ40x6/tdkRB+9gihNAAagPTFM3u/BKTDXUC4JBHATM6nq+MP2c7wUBcQ6pIAjADS14it7L2cAHwQNiUBaLIGPLFdvm6Xsu4vOxiAsM7qEQNgljXAHe/twC6Oe04qgOusAe74fcqejVQRwKRnB9e2wf9x0t8VBCIWwIBnEvO5UVUANTu2PwaCn48IRDQA4wP2oOMb6/aNyEDEA+h4dwZivGDCqzSAXq0AygxgxXnBhn3p//ZjFkhsucv8PCEFgAUht8SMJ1IAmBISvNlEDaW6Kdqyx1JlDv5EqouS7q2OaXufpyxu2gPYoWRXZVUqlUqlUqlUFdM/lkF4sYxV/wAAAAAASUVORK5CYII="><style>
:root{color-scheme:dark;--canvas:#080a0e;--surface-0:#0d1016;--surface-1:#11161e;--surface-2:#171d27;--surface-3:#1d2531;--line:#29313d;--line-strong:#3a4656;--text:#eef2f7;--muted:#909baa;--subtle:#687382;--green:#38d27a;--blue:#68a7ff;--red:#ff5c68;--amber:#f3b954}
:root{color-scheme:dark;font-family:system-ui,sans-serif;background:var(--canvas);color:var(--text);--cellh:clamp(2.8rem,6vw,4.5rem)}*{box-sizing:border-box}body{margin:0}main{max-width:900px;margin:auto;padding:20px}header{display:flex;gap:12px;align-items:center}header img{width:38px;height:38px}h1{font-size:1.35rem;margin:0}p{line-height:1.5}.muted{color:var(--muted);font-size:.9rem}.bar,form{display:flex;flex-wrap:wrap;gap:10px;align-items:center}button,input{font:inherit;border:1px solid var(--line);border-radius:9px;padding:10px 14px;background:var(--surface-2);color:inherit}button{cursor:pointer;min-height:44px}button:hover{background:var(--surface-3)}button:focus-visible,input:focus-visible{outline:2px solid var(--blue);outline-offset:2px}button:active{background:var(--surface-1)}button:disabled{opacity:.45;cursor:not-allowed}.primary{font-weight:700}.red-action{background:color-mix(in srgb,var(--red) 28%,var(--surface-1));border-color:var(--red)}form{margin:18px 0}label{display:grid;gap:5px;font-size:.85rem}input{width:180px;max-width:100%}.basic-grid{display:grid;grid-template-columns:repeat(10,minmax(0,1fr));gap:6px;margin:24px 0 18px;padding-bottom:calc(var(--cellh)/2 + 3px)}.basic-cell{height:var(--cellh);min-height:0;min-width:0;padding:0;background:var(--surface-1);box-shadow:inset 0 0 0 2px transparent}.basic-cell:nth-child(odd){transform:translateY(calc(50% + 3px))}.basic-cell.red{background:color-mix(in srgb,var(--red) 24%,var(--surface-1));color:var(--text)}.basic-cell.selected{box-shadow:inset 0 0 0 2px var(--blue);background:color-mix(in srgb,var(--blue) 15%,var(--surface-1))}.basic-cell.red.selected{background:color-mix(in srgb,var(--red) 24%,var(--surface-2))}.basic-cell:focus-visible{outline-offset:-5px}.status{border:1px solid var(--line);background:var(--surface-0);border-radius:10px;padding:12px;min-height:4rem}.status p{margin:0}.selection{font-weight:650;margin-right:auto}a{color:var(--blue)}[hidden]{display:none!important}@media(max-width:500px){main{padding:12px}.bar button{flex:1}.bar .selection{flex-basis:100%}form label{flex:1;min-width:120px}input{width:100%}.basic-cell{font-size:.8rem}}
</style></head><body><main>
<header><img src="data:image/png;base64,iVBORw0KGgoAAAANSUhEUgAAAEAAAABACAYAAACqaXHeAAACq0lEQVR42u2av2sUQRTHT2MsJASJdqZKUP8ABRuxEBJ/nFoF0thdzn9ARC18xfG6i6+yCdopEUwE7Y2lBJMQqxSiaGwURBDBGFGjOzAHw2N2du5wYN/e+8K3mZ2Znfe5mdmZm6nVVCqVSqVSqVSqoADJeBiQEJCWAGm1RF4BpAVAmrLtTALABP8akP6W3K1UAFBA8Ma/AWksBYAl5yXfC7qk26DPgXwbLO/7HocAr2c6BQA3sNXOWMux25i5QL5jLO+Vgnqj61EACkABiATQ7jcAY57P2NV+AmB83wPhRj8B2GOXsRzCA0Bas2uOt4C0CEjHqwggBIH7VwbkmjQAdyO7cSyEHUA6LQnAFiBNREI46Qn2OSBtsvRXkgB0IExGALjFyjVt+gAgLbMNzz5JAGIhECsz6jxrsWdHpAEw/gFIZwLlZlj+WUDaa0G8cdK3AWlQCoAdD4SzOeWO2pmeb6d52jNJc8DDrOu/8EA4l1O26I+XLQtK1DpguAsIpsvf8fQc40+AdF7qQsgHYTsnIONTgHTbdvdHgHQzA3NQ+kowD0K9x12gyKVwHoQL/QIgBOFiFQDsZ40x6/tdkRB+9gihNAAagPTFM3u/BKTDXUC4JBHATM6nq+MP2c7wUBcQ6pIAjADS14it7L2cAHwQNiUBaLIGPLFdvm6Xsu4vOxiAsM7qEQNgljXAHe/twC6Oe04qgOusAe74fcqejVQRwKRnB9e2wf9x0t8VBCIWwIBnEvO5UVUANTu2PwaCn48IRDQA4wP2oOMb6/aNyEDEA+h4dwZivGDCqzSAXq0AygxgxXnBhn3p//ZjFkhsucv8PCEFgAUht8SMJ1IAmBISvNlEDaW6Kdqyx1JlDv5EqouS7q2OaXufpyxu2gPYoWRXZVUqlUqlUqlUFdM/lkF4sYxV/wAAAAAASUVORK5CYII=" alt=""><div><h1>PakarController · Cells</h1><div id="basicBoard" class="muted">No verified board</div></div></header>
<p class="muted">Select a numbered logical cell, then choose White or Red. Each cell contains six LEDs. No background polling or animation.</p>
<form id="basicLogin" hidden><label>Username<input id="basicUsername" autocomplete="username" required></label><label>Password<input id="basicPassword" type="password" autocomplete="current-password" required></label><button id="basicSignIn" type="submit">Sign in</button></form>
<p id="basicDefaultHint" class="muted" hidden>Public development defaults are active: username admin, password pakarcontroller. Reconfigure credentials in the full application.</p>
<div class="bar"><button id="basicRefresh" type="button">Refresh</button><button id="basicEnable" type="button" disabled>Enable static output</button></div>
<div id="basicGrid" class="basic-grid" aria-label="80 logical cells in row-major order"></div>
<div class="bar"><span id="basicSelection" class="selection">Logical cell 1</span><button id="basicWhite" class="primary" type="button" disabled>White</button><button id="basicRed" class="primary red-action" type="button" disabled>Red</button></div>
<div class="status" role="status" aria-live="polite"><p id="basicStatus">Unknown. Refresh to read the board.</p><p id="basicReadiness" class="muted"></p></div>
<p class="muted">Colors show only verified board readback, not optical confirmation. Failed or uncertain commands are not retried. <a href="/">Full application</a></p>
</main><script>// Adapted from RayanLamp webui/src/api.ts: APIError, Headers, same-origin
// no-store requests, AbortController deadline and finally cleanup. No 401 replay.
// Board/session admission follows PCController internal/link/session.go; the
// boot identity itself comes from Pakar's server, never a hostname/build stamp.
class PeerAPIError extends Error {
  constructor(message, status = 0, code = '') {
    super(message); this.name = 'PeerAPIError'; this.status = status; if (code) this.code = code;
  }
}
// Build identity belongs to this shipped client, never to the board it reads.
// Generators replace this one literal from interfaces/client-release.json.
const PAKAR_WEB_BUILD = {"application":"pakarcontroller-web","version":"0.2.8","build":18,"minimum_board":"0.2.8","maximum_board":null,"enforcePeerVersions":true};
function peerSemver(value) {
  if(typeof value!=='string'||value.length>63)return null;
  const m=/^(0|[1-9]\d*)\.(0|[1-9]\d*)\.(0|[1-9]\d*)(?:-([0-9A-Za-z-]+(?:\.[0-9A-Za-z-]+)*))?(?:\+[0-9A-Za-z-]+(?:\.[0-9A-Za-z-]+)*)?$/.exec(value);
  if(!m)return null;
  const numbers=m.slice(1,4).map(Number),pre=m[4]?.split('.')??[];
  if(numbers.some(n=>!Number.isSafeInteger(n)||n>0xffffffff)||pre.some(s=>/^\d+$/.test(s)&&s.length>1&&s.startsWith('0')))return null;
  return {numbers,pre};
}
function peerVersionCompare(left,right) {
  const a=peerSemver(left),b=peerSemver(right);if(!a||!b)return null;
  for(let i=0;i<3;i++)if(a.numbers[i]!==b.numbers[i])return a.numbers[i]<b.numbers[i]?-1:1;
  if(!a.pre.length||!b.pre.length)return a.pre.length===b.pre.length?0:a.pre.length?-1:1;
  for(let i=0;i<Math.max(a.pre.length,b.pre.length);i++){
    if(a.pre[i]===undefined)return -1;if(b.pre[i]===undefined)return 1;
    const x=a.pre[i],y=b.pre[i];if(x===y)continue;
    const nx=/^\d+$/.test(x),ny=/^\d+$/.test(y);
    if(nx&&ny)return x.length!==y.length?(x.length<y.length?-1:1):(x<y?-1:1);
    if(nx!==ny)return nx?-1:1;return x<y?-1:1;
  }
  return 0;
}
function peerVersionAllowed(value,minimum,maximum) {
  const lower=peerVersionCompare(value,minimum);
  return lower!==null&&lower>=0&&(maximum==null||(peerVersionCompare(value,maximum)!==null&&peerVersionCompare(value,maximum)<0));
}
let pakarBrowserIdentity;
function browserPeerIdentity() {
  if(pakarBrowserIdentity)return pakarBrowserIdentity;
  let id;try{id=globalThis.sessionStorage?.getItem('pakar-peer-session')}catch{}
  if(!/^[a-f0-9]{8}-[a-f0-9]{4}-4[a-f0-9]{3}-[89ab][a-f0-9]{3}-[a-f0-9]{12}$/.test(id??'')){
    const bytes=new Uint8Array(16);
    if(!globalThis.crypto?.getRandomValues)throw new PeerAPIError('Secure session identity is unavailable.',0,'client_identity_unavailable');
    globalThis.crypto.getRandomValues(bytes);bytes[6]=(bytes[6]&15)|64;bytes[8]=(bytes[8]&63)|128;
    const hex=Array.from(bytes,b=>b.toString(16).padStart(2,'0')).join('');id=[hex.slice(0,8),hex.slice(8,12),hex.slice(12,16),hex.slice(16,20),hex.slice(20)].join('-');
    try{globalThis.sessionStorage?.setItem('pakar-peer-session',id)}catch{}
  }
  return pakarBrowserIdentity=Object.freeze({...PAKAR_WEB_BUILD,id});
}
function createPeerHttp({fetcher = (...args) => fetch(...args), now = () => Date.now(),
  setTimer = setTimeout, clearTimer = clearTimeout, changed = () => {},
  clientIdentity = browserPeerIdentity,
  enforceVersions = globalThis.PAKAR_ENFORCE_PEER_VERSIONS ?? PAKAR_WEB_BUILD.enforcePeerVersions} = {}) {
  let owner = null, generation = 0, observed = 0, versionError = null, serverIdentity = null;
  function acceptVersion(s) {
    serverIdentity={...serverIdentity,application:typeof s?.application==='string'?s.application:typeof s?.application?.id==='string'?s.application.id:null,
      name:typeof s?.application?.name==='string'?s.application.name:null,version:typeof s?.version==='string'?s.version:null,
      board_id:typeof s?.board_id==='string'?s.board_id:null,boot_id:typeof s?.boot_id==='string'?s.boot_id:null};
    if(enforceVersions===false){versionError=null;return;}
    const policy=s?.compatibility,client=clientIdentity();
    if(!peerVersionAllowed(s?.version,PAKAR_WEB_BUILD.minimum_board,PAKAR_WEB_BUILD.maximum_board)||
      (policy?.enforced!==false&&policy?.minimum_app!==undefined&&!peerVersionAllowed(client.version,policy.minimum_app,policy.maximum_app))) {
      versionError=new PeerAPIError('Unsupported board or application version. Update the incompatible peer before connecting.',426,'unsupported_peer_version');
      revoke();throw versionError;
    }
    versionError=null;
  }
  function identity(s) {
    return s?.http_peer_fencing === true && typeof s.board_id === 'string' && typeof s.boot_id === 'string' && /^[a-z0-9_-]{1,64}$/.test(s.board_id) &&
      /^[a-f0-9]{32}$/.test(s.boot_id ?? '') && !/^0{32}$/.test(s.boot_id)
      ? {board: s.board_id, boot: s.boot_id} : null;
  }
  function observe(s) {
    acceptVersion(s);
    const next = identity(s);
    if (owner?.board !== next?.board || owner?.boot !== next?.boot) {
      owner = next; generation++; changed();
    }
    observed = now();
  }
  function revoke() { owner = null; observed = 0; generation++; changed(); }
  function pin() {
    if(versionError)throw versionError;
    const age = now() - observed;
    if (!owner || age < 0 || age >= 8000)
      throw new PeerAPIError('Refresh this board before writing; its boot identity is unavailable or stale.', 409, 'peer_unavailable');
    return Object.freeze({...owner, generation});
  }
  function assertOwner(peer) {
    if (!peer || peer.generation !== generation || peer.board !== owner?.board || peer.boot !== owner?.boot)
      throw new PeerAPIError('Board or boot changed. Old edits were not transferred; refresh before a new action.', 409, 'peer_changed');
  }
  async function request(path, options = {}) {
    if (typeof path !== 'string' || !/^\/(?!\/)/.test(path) || /[\x00-\x20\\]/.test(path))
      throw new PeerAPIError('Only same-origin device paths are allowed.', 400, 'invalid_endpoint');
    const {peer: expected, timeoutMs = 12000, signal: external, ...init} = options;
    const method = String(init.method || 'GET').toUpperCase(), endpoint = path.split('?')[0];
    const mutation = !['GET', 'HEAD'].includes(method), localAuth = ['/login', '/logout'].includes(endpoint);
    const peer = expected || (mutation && !localAuth ? pin() : null);
    if (peer) assertOwner(peer);
    if (mutation && !localAuth) {
      // One read preflight, never a mutation retry. The server closes the race
      // between this observation and admission of the pinned POST/upload.
      await request('/api/status', {signal: external, peer, timeoutMs});
      assertOwner(peer);
    }
    const admission = generation, controller = new AbortController();
    let timedOut = false, timer;
    const abort = () => {controller.abort(); if (timer !== undefined) clearTimer(timer);};
    if (external?.aborted) abort(); else external?.addEventListener('abort', abort, {once: true});
    timer = setTimer(() => {timedOut = true; abort();}, Math.max(1, Math.min(60000, timeoutMs)));
    if (controller.signal.aborted) clearTimer(timer);
    try {
      if (controller.signal.aborted) throw new PeerAPIError('Request cancelled.', 0, 'cancelled');
      const headers = new Headers(init.headers); headers.set('Accept', 'application/json');
      headers.delete('User-Agent');
      const client=clientIdentity();
      // Browsers own User-Agent; do not forge it or copy a board's version.
      headers.set('X-Pakar-Client',client.application);headers.set('X-Pakar-Version',client.version);
      headers.set('X-Pakar-Client-Id',client.id);headers.set('X-Pakar-Build',String(client.build));
      if (peer) {headers.set('X-Pakar-Board', peer.board); headers.set('X-Pakar-Boot', peer.boot);}
      const response = await fetcher(path, {...init, method, headers, credentials: 'same-origin', cache: 'no-store', redirect: 'error', signal: controller.signal});
      const responseHeaders={};for(const key of ['Server','X-Pakar-Application','X-Pakar-Version','X-Pakar-Build','X-Pakar-Board','X-Pakar-Boot','X-Pakar-Board-Version','X-Pakar-Min-App-Version','X-Pakar-Version-Check']){
        const value=response.headers?.get(key);if(value)responseHeaders[key]=value.slice(0,160);
      }
      const text = await response.text();
      if (controller.signal.aborted) throw new PeerAPIError('Request cancelled.', 0, 'cancelled');
      if (!localAuth && admission !== generation) throw new PeerAPIError('Late reply from a previous board session was ignored.', 409, 'peer_changed');
      serverIdentity={...serverIdentity,headers:responseHeaders};
      let value;
      try {value = JSON.parse(text);} catch {
        if (response.headers?.get('Content-Type')?.includes('application/json'))
          throw new PeerAPIError('Device returned malformed JSON.', 502, 'invalid_response');
        value = text; // Existing plain-text firmware receipts remain supported.
      }
      if (!response.ok) {
        if (response.status === 409 && value?.error === 'peer_changed') revoke();
        const reported = typeof value?.error === 'string' ? value.error : value?.error?.code;
        const code = typeof reported === 'string' && /^[a-z][a-z0-9_.-]{0,63}$/.test(reported) ? reported : '';
        throw new PeerAPIError(response.status === 401 ? (endpoint === '/login' ? 'Incorrect username or password' : 'Please sign in again') : 'Device request failed (' + response.status + ').', response.status, code);
      }
      if (endpoint === '/api/status' && method === 'GET') observe(value);
      if (endpoint === '/api/peer/info' && method === 'GET') acceptVersion(value);
      if (peer) assertOwner(peer);
      return value;
    } catch (error) {
      if (timedOut) throw new PeerAPIError('Request timed out. A sent write may have applied; it was not retried.', 408, 'timeout');
      if (external?.aborted) throw new PeerAPIError('Request cancelled. A sent write may have applied; it was not retried.', 0, 'cancelled');
      throw error;
    } finally {clearTimer(timer); external?.removeEventListener('abort', abort);}
  }
  function webSocketUrl(value) {
    const url=new URL(value),client=clientIdentity();
    url.searchParams.set('client',client.application);url.searchParams.set('version',client.version);
    url.searchParams.set('client_id',client.id);url.searchParams.set('build',String(client.build));
    return url.href;
  }
  function report({settings={}}={}) {
    const client=clientIdentity(),nav=globalThis.navigator??{},display=globalThis.screen??{};
    const text=(v,n)=>typeof v==='string'?v.slice(0,n):undefined;
    const visible={};for(const key of ['language','theme','direction','palette','sound','transport'])if(['string','boolean','number'].includes(typeof settings[key]))visible[key]=typeof settings[key]==='string'?settings[key].slice(0,48):settings[key];
    const value={id:client.id,session_id:client.id,application:client.application,version:client.version,build:String(client.build),
      os:text(nav.userAgentData?.platform??nav.platform,32),user_agent:text(nav.userAgent,256),transport:'http',
      hardware:{cpu_count:Number.isInteger(nav.hardwareConcurrency)&&nav.hardwareConcurrency>0&&nav.hardwareConcurrency<=65535?nav.hardwareConcurrency:undefined,
        memory_mb:Number.isFinite(nav.deviceMemory)&&nav.deviceMemory>0&&nav.deviceMemory<4096?Math.floor(nav.deviceMemory*1024):undefined},
      capabilities:['http','websocket','cell-batch','peer-version-policy'],settings:visible};
    for(const [key,n]of [['screen_width',display.width],['screen_height',display.height]])if(Number.isInteger(n)&&n>0&&n<=65535)value[key]=n;
    return value;
  }
  return {request, pin, assertOwner, observe, revoke, webSocketUrl, report, clientIdentity,
    peerIdentity:()=>serverIdentity?{...serverIdentity}:null,
    writable: () => {try {pin(); return true;} catch {return false;}}};
}

// Actual shared createPeerHttp owns identity fencing, deadlines and no replay.
// PCController peripheral-availability.ts: ready AND explicitly advertised.
function createBasicCells({http,changed=()=>{}}){
  let observed=null,selected=1,busy=false,message='Unknown. Refresh to read the board.',authInfo=null;
  function table(s){const c=s?.capabilities,f=c?.acknowledged_features;return c?.board_kind==='table'&&Array.isArray(f)&&f.includes('table')&&f.includes('leds')&&c.table?.columns===10&&c.table?.rows===8&&c.table?.pixels_per_cell===6&&s.pixels===480&&Array.isArray(s.cells)&&s.cells.length===80&&s.cells.every(v=>['white','red','off'].includes(v))}
  function batch(s){return s?.capabilities?.acknowledged_features?.includes('cell-batch')===true}
  function supportedDriver(s){const d=s?.led_output?.driver;return d?.ready===true&&((d.backend==='gpio-static'&&d.dma===false)||(d.backend==='rmt-dma'&&d.dma===true))}
  function ready(s){return table(s)&&batch(s)&&s.led_output?.enabled===true&&s.led_output.mode==='static'&&supportedDriver(s)}
  function reason(){if(!observed)return 'Unknown. Refresh needed before another command.';if(!batch(observed))return 'This board has not acknowledged atomic cell batches. Update its firmware; no per-cell fallback is used.';if(!supportedDriver(observed))return 'LED output driver is unavailable. Refresh after updating the board.';if(observed.led_output?.enabled!==true||observed.led_output.mode!=='static')return 'LED output is disabled or in effects mode. Enable static output explicitly.';return 'Static rendering ready via '+(observed.led_output.driver.dma?'RMT DMA':'GPIO')+'. Board readback is not optical verification.'}
  function snapshot(){return {selected,busy,known:!!observed,cells:observed?observed.cells.slice():Array(80).fill(null),hostname:observed?.hostname||'',message,reason:reason(),canWrite:!busy&&ready(observed),canEnable:!busy&&table(observed)&&batch(observed)&&supportedDriver(observed),authInfo:authInfo?{...authInfo}:null}}
  function publish(){changed(snapshot())}
  function check(s){if(!table(s))throw Error('This peer has not acknowledged the 80-cell / 480-pixel table.');return s}
  function unknown(error){observed=null;http.revoke();message=(error?.message||'Connection failed.')+' Unknown; Refresh needed. A sent command was not retried.'}
  async function perform(action){if(busy)return false;busy=true;publish();try{return await action()}catch(error){unknown(error);return false}finally{busy=false;publish()}}
  function select(id){if(!Number.isInteger(id)||id<1||id>80)return false;selected=id;publish();return true}
  async function refresh(){return perform(async()=>{const info=await http.request('/api/auth/info');authInfo={enabled:info?.enabled===true,username:typeof info?.username==='string'?info.username:'',default_credentials:info?.enabled===true&&info?.default_credentials===true};const s=check(await http.request('/api/status'));http.pin();observed=s;message='Board status read. Select a logical cell.';return true})}
  async function loadAuthInfo(){return perform(async()=>{const value=await http.request('/api/auth/info');authInfo={enabled:value?.enabled===true,username:typeof value?.username==='string'?value.username:'',default_credentials:value?.enabled===true&&value?.default_credentials===true};return true})}
  async function login(username,password){return perform(async()=>{const ack=await http.request('/login',{method:'POST',body:new URLSearchParams({username,password})});if(ack?.authenticated!==true)throw Error('Sign-in was not acknowledged.');observed=check(await http.request('/api/status'));http.pin();message='Signed in. Board status read.';return true})}
  async function write(kind,value){
    if(busy)return false;
    if(kind==='cell'&&!['white','red'].includes(value))return false;
    const id=selected;
    return perform(async()=>{
      const previous=observed;if(!previous)throw Error('Read the board before writing.');
      // Refresh stale admission without transferring an old click to a new boot.
      const before=check(await http.request('/api/status'));
      if(before.board_id!==previous.board_id||before.boot_id!==previous.boot_id)throw Error('Board or boot changed. Refresh before a new command.');
      const peer=http.pin();
      if(kind==='cell'&&!ready(before)){observed=before;message=reason();return false}
      if(kind==='enable'&&(!batch(before)||!supportedDriver(before))){observed=before;message=reason();return false}
      const path=kind==='cell'?'/api/cells':'/api/led/output?enabled=true&mode=static';
      const body=kind==='cell'?new URLSearchParams({ids:String(id),state:value,effect:'immediate'}):'';
      const ack=await http.request(path,{method:'POST',peer,body});
      if(kind==='cell'?ack?.accepted!==true||ack.count!==1:ack?.enabled!==true||ack.mode!=='static')throw Error('Command was not acknowledged.');
      const after=check(await http.request('/api/status',{peer}));
      if(!ready(after)||(kind==='cell'&&after.cells[id-1]!==value))throw Error('Board readback did not confirm the requested state and static rendering.');
      observed=after;message=kind==='cell'?`Logical cell ${id}: ${value} verified by board readback. Inspect the actual LEDs.`:'Static output enabled and verified by board readback.';return true;
    });
  }
  return {snapshot,select,refresh,loadAuthInfo,login,setColor:value=>write('cell',value),enableStatic:()=>write('enable')};
}
if(typeof document!=='undefined'){
  const byId=id=>document.getElementById(id),buttons=[];
  function renderBasic(s){
    byId('basicStatus').textContent=s.message;byId('basicReadiness').textContent=s.reason;
    byId('basicBoard').textContent=s.hostname?s.hostname+'.local':'No verified board';
    byId('basicLogin').hidden=s.known||s.authInfo?.enabled!==true;
    byId('basicSelection').textContent='Logical cell '+s.selected;
    byId('basicWhite').disabled=byId('basicRed').disabled=!s.canWrite;byId('basicEnable').disabled=!s.canEnable;byId('basicRefresh').disabled=s.busy;byId('basicSignIn').disabled=s.busy;
    byId('basicDefaultHint').hidden=s.authInfo?.default_credentials!==true;
    if(s.authInfo?.username&&!byId('basicUsername').value)byId('basicUsername').value=s.authInfo.username;
    buttons.forEach((button,index)=>{button.classList.toggle('selected',s.selected===index+1);button.classList.toggle('red',s.known&&s.cells[index]==='red');button.setAttribute('aria-pressed',String(s.selected===index+1));button.setAttribute('aria-label',`Logical cell ${index+1}, ${s.cells[index]??'Unknown'}`)});
  }
  const controller=createBasicCells({http:createPeerHttp(),changed:renderBasic});
  for(let id=1;id<=80;id++){const b=document.createElement('button');b.type='button';b.className='basic-cell';b.textContent=String(id);b.onclick=()=>controller.select(id);byId('basicGrid').appendChild(b);buttons.push(b)}
  byId('basicWhite').onclick=()=>controller.setColor('white');byId('basicRed').onclick=()=>controller.setColor('red');
  byId('basicEnable').onclick=()=>controller.enableStatic();byId('basicRefresh').onclick=()=>controller.refresh();
  byId('basicLogin').onsubmit=async event=>{event.preventDefault();const password=byId('basicPassword').value;byId('basicPassword').value='';await controller.login(byId('basicUsername').value,password)};
  renderBasic(controller.snapshot());controller.refresh();
}
</script></body></html>
)BASIC";
